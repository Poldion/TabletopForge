## kiosk/buildroot/Config.in
```kconfig
source "$BR2_EXTERNAL_DND_KIOSK_PATH/package/armbian-kernel/Config.in"
source "$BR2_EXTERNAL_DND_KIOSK_PATH/package/uwe5622-firmware/Config.in"
```

## kiosk/buildroot/package/armbian-kernel/Config.in
```kconfig
config BR2_PACKAGE_ARMBIAN_KERNEL
	bool "armbian-kernel"
	help
	  Kernel, Gerätebaum und Module aus selbst gebauten Armbian-Kernelpaketen (.deb) – für Geräte, deren
	  Unterstützung (HDMI, WLAN-Treiber) nur in den Armbian-Patches steckt, z.B. den Orange Pi Zero 2W.
	  Die Pakete legt build.sh nach armbian-debs/ (gebaut mit Armbians compile.sh, siehe README).
```

## kiosk/buildroot/package/uwe5622-firmware/Config.in
```kconfig
config BR2_PACKAGE_UWE5622_FIRMWARE
	bool "uwe5622-firmware"
	help
	  Firmware des WLAN-Chips UWE5622/AW859A (Orange Pi Zero 2W, Zero 3) aus dem Armbian-Firmware-Archiv.
```
